#include <Arduino.h>
#include <algorithm>


#include "WifiConfig.hpp"

#include <ESPNtpClient.h>
#ifdef ESP32
#include <WiFi.h>
#elif defined ESP8266
#include <ESP8266WiFi.h>
#include <core_esp8266_waveform.h> 
#endif

/*  
    CONFIGURATION
*/

// Address of NTP Server
const PROGMEM char* ntpServer = "ntp1.tp.pl";

// Target clock frequency generated by device [Hz]
#define GENERATOR_FREQUENCY 32768

// Interval of NTP sychronization [s]
#define SYNC_INTERVAL_SECONDS 600

// Interval of switching between imperfect frequencies [ms]
#define COMPENSATOR_INTERVAL_MS 3000

// Output pin of generated signal
#define GPIO_GENERATOR_OUTPUT D3

// Output pin of RESET test signal - pulled LOW on device reset, HIGH after initializing generator
#define GPIO_GENERATOR_RESET D2




// ESPNtpClient globals
boolean syncEventTriggered = false; // True if a time even has been triggered
NTPEvent_t ntpEvent; // Last triggered event

int32_t catchUpCycles = 0;
double frequencyTarget = GENERATOR_FREQUENCY;
double frequencyReal = 0.0;
double frequencyDiff = 0.0;
double periodsAhead = 0.0;
int32_t lastSync = 0;

uint32_t lastCompensatorEventCC = 0;

void setClockFreq(double freq);
void compensateLostPulses(void);
static inline uint32_t asm_ccount(void);
void initSync(void);
void setClockFreqTarget(double freq);

Ticker compensatorTicker;

void processSyncEvent (NTPEvent_t ntpEvent) {
    Serial.printf ("[NTP-event] %s\n", NTP.ntpEvent2str(ntpEvent));

    if((ntpEvent.event==0 || ntpEvent.event==2) && ntpEvent.info.offset < 10.0 && abs(ntpEvent.info.offset) > 0.0025){
        double periodsAheadNTP = ntpEvent.info.offset * GENERATOR_FREQUENCY;
        periodsAhead += periodsAheadNTP;
        Serial.printf ("periodsAHEAD=%f\n", periodsAheadNTP);

    }

    if(ntpEvent.event==0 || ntpEvent.event==3){
        NTP.stop();
        WiFi.mode( WIFI_OFF );
        WiFi.forceSleepBegin();
        delay( 1 );

    }
}


void setup () {
    Serial.begin (115200);
    Serial.println ();

    //WiFi.mode(WIFI_STA);
    //wifi_set_sleep_type(LIGHT_SLEEP_T);
    WiFi.begin (YOUR_WIFI_SSID, YOUR_WIFI_PASSWD);
    NTP.setTimeZone (TZ_Etc_UTC);
    NTP.onNTPSyncEvent ([] (NTPEvent_t event) {
        ntpEvent = event;
        syncEventTriggered = true;
    });
    
    initSync();
    pinMode (GPIO_GENERATOR_OUTPUT, OUTPUT);
    pinMode (GPIO_GENERATOR_RESET, OUTPUT);
    digitalWrite (GPIO_GENERATOR_OUTPUT, HIGH);
    digitalWrite (GPIO_GENERATOR_RESET, LOW);

    compensatorTicker.attach_ms(COMPENSATOR_INTERVAL_MS, compensateLostPulses);

    setClockFreqTarget(GENERATOR_FREQUENCY);
}

void loop () {
    static uint32_t cyclesLast=0, cycleAccum=0;
    static uint32_t halfPulses=0;
   
    uint32_t r=asm_ccount();
    uint32_t dr = r-cyclesLast;
    cyclesLast = r;
    cycleAccum+=dr*16;

    if (syncEventTriggered) {
        syncEventTriggered = false;
        processSyncEvent (ntpEvent);
    }

    if (millis() - lastSync >= SYNC_INTERVAL_SECONDS*1000) {

        initSync();
    }
}

void setClockFreq(double freq){
    double pulseTimeUS = (double)CPU_CLK_FREQ / freq;
    uint32_t timeHighUS = round(pulseTimeUS*0.5);
    uint32_t timeLowUS = round(pulseTimeUS) - timeHighUS;
    frequencyReal = (double)CPU_CLK_FREQ / (double)(timeHighUS+timeLowUS);
    frequencyDiff = frequencyTarget - frequencyReal;
    Serial.printf ("FreqSet %.2f THL=%d REAL=%.2f DIFF=%.2f CAH=%.2f WC=%d\n", 
        freq, (timeHighUS+timeLowUS), frequencyReal, frequencyDiff, periodsAhead, (int)WiFi.isConnected ());
    startWaveformClockCycles(GPIO_GENERATOR_OUTPUT, timeHighUS+1, timeLowUS+1, 0, -1, 0, false);
    digitalWrite (GPIO_GENERATOR_RESET, HIGH);
}

void setClockFreqTarget(double freq){
    frequencyTarget = freq;
    setClockFreq(freq);
}


void compensateLostPulses(void){
    static uint32_t ccLast = asm_ccount();
    uint32_t currentCC = asm_ccount();
    uint32_t deltaCC = currentCC - ccLast;

    ccLast = currentCC;
    double deltaSeconds = (double)deltaCC / (double)(CPU_CLK_FREQ);


    //Serial.printf ("DCC=%d DSEC=%.2f\n",deltaCC, deltaSeconds);
    // calculate cycles ahead since last call
    periodsAhead += frequencyDiff * deltaSeconds;
    double cyclesToCompensate = periodsAhead / deltaSeconds;

    cyclesToCompensate = min(50.0, max(-50.0, cyclesToCompensate));
    // adjust clock 

    setClockFreq(frequencyTarget + cyclesToCompensate);

}


void initSync(void){
    Serial.printf ("InitSync LS=%d\n",lastSync);
    lastSync = millis();
    

    WiFi.forceSleepWake();
    delay( 1 );
    WiFi.mode( WIFI_STA );
    WiFi.reconnect();

    NTP.setInterval (999999);
    NTP.begin (ntpServer, true);

}


static inline uint32_t asm_ccount(void) {

    uint32_t r;

    asm volatile ("rsr %0, ccount" : "=r"(r));
    return r;
}